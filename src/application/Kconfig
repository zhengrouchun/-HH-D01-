## src/application/Kconfig
```kconfig
#===============================================================================
# @brief    Kconfig file.
# Copyright (c) HiSilicon (Shanghai) Technologies Co., Ltd. 2023-2023. All rights reserved.
#===============================================================================

choice
    prompt "ClearChain display SLE role"
    default CLEARCHAIN_DISPLAY_SLE_OFF

config CLEARCHAIN_DISPLAY_SLE_OFF
    bool "ClearChain display SLE disabled"

config CLEARCHAIN_DISPLAY_SLE_SERVER
    bool "ClearChain display SLE server (Board A)"

config CLEARCHAIN_DISPLAY_SLE_CLIENT
    bool "ClearChain display SLE client (Board B)"
    select DRIVER_SUPPORT_SPI
    select SPI_SUPPORT_MASTER
    select OPEN_SOURCE_LVGL

endchoice

config CLEARCHAIN_DEVICE_API
    bool "ClearChain phone-controlled device API (Board A)"
    default n
    depends on CLEARCHAIN_DISPLAY_SLE_SERVER

config CLEARCHAIN_DEVICE_HOST
    string "Raspberry Pi / mock API IPv4 address"
    default "192.168.4.1"
    depends on CLEARCHAIN_DEVICE_API

config CLEARCHAIN_DEVICE_PORT
    int "Raspberry Pi / mock API HTTP port"
    default 5000
    range 1 65535
    depends on CLEARCHAIN_DEVICE_API

config CLEARCHAIN_DISPLAY_CLIENT_MTU_SIZE
    int "ClearChain display client MTU"
    default 520
    range 64 520
    depends on CLEARCHAIN_DISPLAY_SLE_CLIENT

config CLEARCHAIN_DISPLAY_SLE_LINK_TEST
    bool "Send one ClearChain display link test after each connection"
    default n
    depends on CLEARCHAIN_DISPLAY_SLE_SERVER

config CLEARCHAIN_UPLOAD_ENABLED
    bool "Enable real ClearChain RFID upload"
    default n
    depends on !CLEARCHAIN_DISPLAY_SLE_CLIENT

config CLEARCHAIN_BACKEND_CONFIRMED
    bool "Backend destination and authentication confirmed"
    default n
    depends on CLEARCHAIN_UPLOAD_ENABLED

config SUPPORT_SLE_PERIPHERAL
    bool
    default y if CLEARCHAIN_DISPLAY_SLE_SERVER

config SUPPORT_SLE_CENTRAL
    bool
    default y if CLEARCHAIN_DISPLAY_SLE_CLIENT

config SAMPLE_ENABLE
    bool
    prompt "Enable Sample."
    default n
    help
        This option means support Samples.

if SAMPLE_ENABLE
osource "application/samples/Kconfig"
endif
```

## src/application/samples/bt/ble/ble_hello/Kconfig
```kconfig
#===============================================================================
# @brief    Kconfig file for the BLE Hello sample.
# Copyright (c) HiSilicon (Shanghai) Technologies Co., Ltd. 2023-2026.
# All rights reserved.
#===============================================================================

config SAMPLE_SUPPORT_BLE_HELLO_SERVER_SAMPLE
    bool "Support BLE Hello Server Sample"

config SAMPLE_SUPPORT_BLE_HELLO_CLIENT_SAMPLE
    bool "Support BLE Hello Client Sample"
```

## src/application/samples/bt/ble/ble_hid_btn/Kconfig
```kconfig
# BLE HID Button — physical button → HID keyboard keycode

menu "BLE HID Button Configuration"

config BLE_HID_BTN_PIN
    int "Button GPIO pin"
    default 13
    help
        GPIO pin for the physical button (active-low, connect to GND).

config BLE_HID_BTN_KEYCODE
    int "HID keycode (USB HID usage ID)"
    default 78
    help
        HID keyboard keycode sent when button is pressed.
        Common values: 0x4E=PageDown, 0x4B=PageUp, 0x2C=Space,
        0x28=Enter, 0xE9=VolUp, 0xEA=VolDown.

config BLE_HID_BTN_LONGPRESS
    bool "Enable long-press auto-repeat"
    default y
    help
        When enabled, holding the button > 500 ms sends repeated keycodes.

config BLE_HID_DEVICE_NAME
    string "BLE device name"
    default "ble_hid_btn"
    help
        Device name shown during Bluetooth discovery.

endmenu
```

## src/application/samples/bt/sle/Kconfig
```kconfig
#===============================================================================
# @brief    Kconfig file.
# Copyright (c) HiSilicon (Shanghai) Technologies Co., Ltd. 2023-2023. All rights reserved.
#===============================================================================

choice
    prompt "SLE Sample"

config SAMPLE_SUPPORT_SLE_SPEED_SERVER_SAMPLE
    bool "Support SLE Throughput Server Sample."

config LARGE_THROUGHPUT_SERVER
    bool "server large throughput."
    default y
    depends on SAMPLE_SUPPORT_SLE_SPEED_SERVER_SAMPLE

config SAMPLE_SUPPORT_SLE_SPEED_CLIENT_SAMPLE
    bool "Support SLE Throughput Client Sample."

config LARGE_THROUGHPUT_CLIENT
    bool "client large throughput."
    default y
    depends on SAMPLE_SUPPORT_SLE_SPEED_CLIENT_SAMPLE

config SAMPLE_SUPPORT_SLE_HELLO_SERVER_SAMPLE
    bool "Support SLE Hello Server Sample."

config SAMPLE_SUPPORT_SLE_HELLO_CLIENT_SAMPLE
    bool "Support SLE Hello Client Sample."

config SAMPLE_SUPPORT_SLE_UART_SERVER_SAMPLE
    bool "Support SLE UART Server Sample."

config SAMPLE_SUPPORT_SLE_UART_CLIENT_SAMPLE
    bool "Support SLE UART Client Sample."

config SAMPLE_SUPPORT_SLE_SENSOR_REPORT_SERVER_SAMPLE
    bool "Support SLE Sensor Report Server Sample."

config SAMPLE_SUPPORT_SLE_SENSOR_REPORT_CLIENT_SAMPLE
    bool "Support SLE Sensor Report Client Sample."

config SAMPLE_SUPPORT_SLE_CONN_PARAM_TUNING_SERVER_SAMPLE
    bool "Support SLE Connection Parameter Tuning Server Sample."

config SAMPLE_SUPPORT_SLE_CONN_PARAM_TUNING_CLIENT_SAMPLE
    bool "Support SLE Connection Parameter Tuning Client Sample."

config SAMPLE_SUPPORT_SLE_PHY_MCS_SWITCH_SERVER_SAMPLE
    bool "Support SLE PHY/MCS Dynamic Switch Server Sample."

config SAMPLE_SUPPORT_SLE_PHY_MCS_SWITCH_CLIENT_SAMPLE
    bool "Support SLE PHY/MCS Dynamic Switch Client Sample."

config SAMPLE_SUPPORT_SLE_RSSI_RANGING_SERVER_SAMPLE
    bool "Support SLE RSSI Ranging Server Sample."

config SAMPLE_SUPPORT_SLE_RSSI_RANGING_CLIENT_SAMPLE
    bool "Support SLE RSSI Ranging Client Sample."

endchoice

if SAMPLE_SUPPORT_SLE_UART_SERVER_SAMPLE || SAMPLE_SUPPORT_SLE_UART_CLIENT_SAMPLE
osource "application/samples/bt/sle/sle_uart/Kconfig"
endif

if SAMPLE_SUPPORT_SLE_SENSOR_REPORT_SERVER_SAMPLE || SAMPLE_SUPPORT_SLE_SENSOR_REPORT_CLIENT_SAMPLE
osource "application/samples/bt/sle/sle_sensor_report/Kconfig"
endif

if SAMPLE_SUPPORT_SLE_CONN_PARAM_TUNING_SERVER_SAMPLE || SAMPLE_SUPPORT_SLE_CONN_PARAM_TUNING_CLIENT_SAMPLE
osource "application/samples/bt/sle/sle_conn_param_tuning/Kconfig"
endif

if SAMPLE_SUPPORT_SLE_PHY_MCS_SWITCH_SERVER_SAMPLE || SAMPLE_SUPPORT_SLE_PHY_MCS_SWITCH_CLIENT_SAMPLE
osource "application/samples/bt/sle/sle_phy_mcs_switch/Kconfig"
endif

if SAMPLE_SUPPORT_SLE_RSSI_RANGING_SERVER_SAMPLE || SAMPLE_SUPPORT_SLE_RSSI_RANGING_CLIENT_SAMPLE
osource "application/samples/bt/sle/sle_rssi_ranging/Kconfig"
endif
```

## src/application/samples/bt/sle/sle_conn_param_tuning/Kconfig
```kconfig
#===============================================================================
# @brief    Kconfig file for the SLE connection parameter tuning sample.
# Copyright (c) HiSilicon (Shanghai) Technologies Co., Ltd. 2023-2026. All rights reserved.
#===============================================================================

config SUPPORT_SLE_PERIPHERAL
    bool
    default y if SAMPLE_SUPPORT_SLE_CONN_PARAM_TUNING_SERVER_SAMPLE

config SUPPORT_SLE_CENTRAL
    bool
    default y if SAMPLE_SUPPORT_SLE_CONN_PARAM_TUNING_CLIENT_SAMPLE

if SAMPLE_SUPPORT_SLE_CONN_PARAM_TUNING_SERVER_SAMPLE

choice
    prompt "SLE connection parameter profile"
    default SLE_CONN_PARAM_PROFILE_BALANCED

config SLE_CONN_PARAM_PROFILE_LOW_POWER
    bool "Low power: 100 ms interval, latency 49, 12 s timeout"

config SLE_CONN_PARAM_PROFILE_BALANCED
    bool "Balanced: 12.5 ms interval, latency 0, 5 s timeout"

config SLE_CONN_PARAM_PROFILE_LOW_LATENCY
    bool "Low latency: 7.5 ms interval, latency 0, 2 s timeout"

endchoice

endif
```

## src/application/samples/bt/sle/sle_hello/Kconfig
```kconfig
#===============================================================================
# @brief    Kconfig file for SLE Hello World sample.
# Copyright (c) @CompanyNameMagicTag 2023-2023. All rights reserved.
#===============================================================================

config SUPPORT_SLE_PERIPHERAL
    bool
    default y if SAMPLE_SUPPORT_SLE_HELLO_SERVER_SAMPLE

config SUPPORT_SLE_CENTRAL
    bool
    default y if SAMPLE_SUPPORT_SLE_HELLO_CLIENT_SAMPLE
```

## src/application/samples/bt/sle/sle_phy_mcs_switch/Kconfig
```kconfig
#===============================================================================
# @brief    Kconfig file for the SLE PHY/MCS dynamic switch sample.
# Copyright (c) HiSilicon (Shanghai) Technologies Co., Ltd. 2023-2026. All rights reserved.
#===============================================================================

config SUPPORT_SLE_PERIPHERAL
    bool
    default y if SAMPLE_SUPPORT_SLE_PHY_MCS_SWITCH_SERVER_SAMPLE

config SUPPORT_SLE_CENTRAL
    bool
    default y if SAMPLE_SUPPORT_SLE_PHY_MCS_SWITCH_CLIENT_SAMPLE
```

## src/application/samples/bt/sle/sle_rssi_ranging/Kconfig
```kconfig
#===============================================================================
# @brief    Kconfig file for the SLE RSSI ranging sample.
# Copyright (c) HiSilicon (Shanghai) Technologies Co., Ltd. 2023-2026. All rights reserved.
#===============================================================================

config SUPPORT_SLE_PERIPHERAL
    bool
    default y if SAMPLE_SUPPORT_SLE_RSSI_RANGING_SERVER_SAMPLE

config SUPPORT_SLE_CENTRAL
    bool
    default y if SAMPLE_SUPPORT_SLE_RSSI_RANGING_CLIENT_SAMPLE

if SAMPLE_SUPPORT_SLE_RSSI_RANGING_CLIENT_SAMPLE

config SLE_RSSI_RANGING_RSSI_AT_1M
    int "Calibrated RSSI at 1 metre (dBm)"
    range -100 -20
    default -45

config SLE_RSSI_RANGING_PATH_LOSS_TENTHS
    int "Path loss exponent multiplied by 10"
    range 10 60
    default 20

endif
```

## src/application/samples/bt/sle/sle_sensor_report/Kconfig
```kconfig
config SUPPORT_SLE_PERIPHERAL
    bool
    default y if SAMPLE_SUPPORT_SLE_SENSOR_REPORT_SERVER_SAMPLE

config SUPPORT_SLE_CENTRAL
    bool
    default y if SAMPLE_SUPPORT_SLE_SENSOR_REPORT_CLIENT_SAMPLE
```

## src/application/samples/bt/sle/sle_uart/Kconfig
```kconfig
#===============================================================================
# @brief    Kconfig file for SLE UART Bridge sample.
# Copyright (c) HiSilicon (Shanghai) Technologies Co., Ltd. 2023-2026. All rights reserved.
#===============================================================================

config UART_BUS_ID
    int "UART Bus ID"
    default 1

config UART_TXD_PIN
    int "UART TXD Pin"
    default 15

config UART_RXD_PIN
    int "UART RXD Pin"
    default 16

config UART_TXD_PIN_MODE
    int "UART TXD Pin Mode"
    default 1

config UART_RXD_PIN_MODE
    int "UART RXD Pin Mode"
    default 1

config SLE_UART_BAUDRATE
    int "UART Baudrate"
    default 115200

config SLE_UART_RX_BUF_SIZE
    int "UART RX Buffer Size (bytes)"
    default 512

config SLE_UART_MSGQ_LEN
    int "Message Queue Depth"
    default 16

config SLE_UART_MSGQ_ITEM_SIZE
    int "Message Queue Item Size (bytes)"
    default 520

config SLE_UART_MTU_SIZE
    int "SLE MTU Size"
    default 520

config SLE_UART_CONN_INTERVAL
    int "Connection Interval (x1.25ms)"
    default 12
    range 6 32
    help
        Connection interval in units of 1.25ms.
        12 = 15ms, lower values reduce latency but increase power consumption.
config SUPPORT_SLE_PERIPHERAL
    bool
    default y if SAMPLE_SUPPORT_SLE_UART_SERVER_SAMPLE

config SUPPORT_SLE_CENTRAL
    bool
    default y if SAMPLE_SUPPORT_SLE_UART_CLIENT_SAMPLE
```

## src/application/samples/os/Kconfig
```kconfig
#===============================================================================
# @brief    Kconfig file for OSAL and RTOS samples.
# Copyright (c) HiSilicon (Shanghai) Technologies Co., Ltd. 2026. All rights reserved.
#===============================================================================

config SAMPLE_SUPPORT_OSAL_KMALLOC
    bool
    prompt "Support OSAL dynamic memory Sample."
    default n
    depends on ENABLE_OS_SAMPLE
    help
        This option enables the OSAL dynamic memory allocation sample.

config SAMPLE_SUPPORT_OSAL_TASK_CONCURRENCY
    bool
    prompt "Support OSAL task concurrency Sample."
    default n
    depends on ENABLE_OS_SAMPLE
    help
        This option enables the OSAL task concurrency and priority preemption sample.

config SAMPLE_SUPPORT_OSAL_INTERRUPT
    bool
    prompt "Support OSAL interrupt management Sample."
    default n
    depends on ENABLE_OS_SAMPLE
    help
        This option enables the OSAL interrupt registration and handling sample.
```

## src/application/samples/wifi/Kconfig
```kconfig
#===============================================================================
# @brief    Kconfig file.
# Copyright (c) HiSilicon (Shanghai) Technologies Co., Ltd. 2023-2023. All rights reserved.
#===============================================================================
choice
    prompt "Sample"

config SAMPLE_SUPPORT_STA_SAMPLE
    bool "Support WIFI STA Sample"

if SAMPLE_SUPPORT_STA_SAMPLE
osource "application/samples/wifi/sta_sample/Kconfig"
endif

config SAMPLE_SUPPORT_ALILINK_SAMPLE
    bool "Support ALILINK Sample"

if SAMPLE_SUPPORT_ALILINK_SAMPLE
osource "application/samples/wifi/alilink_sample/Kconfig"
endif

config SAMPLE_SUPPORT_SOFTAP_SAMPLE
    bool "Support WIFI SoftAP Sample."

if SAMPLE_SUPPORT_SOFTAP_SAMPLE
osource "application/samples/wifi/softap_sample/Kconfig"
endif

config SAMPLE_SUPPORT_BLE_WIFI_CFG_SAMPLE
    bool "Support BLE WIFI CFG Sample"

if SAMPLE_SUPPORT_BLE_WIFI_CFG_SAMPLE
osource "application/samples/wifi/ble_wifi_cfg_sample/Kconfig"
endif

config SUPPORT_HILINK
    bool "Support HILINK"

config SUPPORT_UAPI
    bool "Support UAPI."
endchoice

config SAMPLE_SUPPORT_SYSCHANNEL_DEV
    bool
    prompt "Support Syschannel dev Sample."
    default n
    help
        This option means support Syschannel Dev Sample.
```
