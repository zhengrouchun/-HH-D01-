## src/application/samples/radar/Kconfig
```kconfig
#===============================================================================
# @brief    Kconfig file.
# Copyright (c) HiSilicon (Shanghai) Technologies Co., Ltd. 2023-2023. All rights reserved.
#===============================================================================

config SUPPORT_RADAR_STA_SAMPLE
    bool "Support RADAR STA Sample"

config SUPPORT_RADAR_SOFTAP_SAMPLE
    bool "Support RADAR SoftAP Sample."

if SUPPORT_RADAR_SOFTAP_SAMPLE
osource "application/samples/radar/softap_sample/Kconfig"
endif

config SUPPORT_RADAR_WIRELESS_SAMPLE
    bool "Support RADAR WIRELESS Sample"

if SUPPORT_RADAR_WIRELESS_SAMPLE
osource "application/samples/radar/wireless_sample/Kconfig"
endif

config SUPPORT_RADAR_SLP_SAMPLE
    bool "Support RADAR SLP Sample"

config SUPPORT_RADAR_SLP_WIRELESS_SAMPLE
    bool "Support RADAR SLP WIRELESS Sample"

if SUPPORT_RADAR_SLP_WIRELESS_SAMPLE
osource "application/samples/radar/slp_wireless_sample/Kconfig"
endif
```

## src/application/samples/radar/slp_wireless_sample/Kconfig
```kconfig
#===============================================================================
# @brief    Kconfig file.
# Copyright (c) HiSilicon (Shanghai) Technologies Co., Ltd. 2026-2026. All rights reserved.
#===============================================================================

menu "SLP WIRELESS Sample Configuration"

config WIFI_SSID
    string "Set WIFI SSID"
    default "my_softAP"
    help
        Configure the target WiFi SSID for SLP WIRELESS STA connection.

config WIFI_PWD
    string "Set WIFI password"
    default "123456789"
    help
        Configure the WiFi password (pre-shared key) for SLP WIRELESS STA connection.

config PC_OUT_NUM
    int
    prompt "cfg PC_OUT_NUM"
    range 30 60
    default 48

config RADAR_ANT_PAIR_NUM
    int
    prompt "cfg RADAR_ANT_PAIR_NUM"
    range 1 4
    default 4

endmenu
```

## src/application/samples/radar/softap_sample/Kconfig
```kconfig
#===============================================================================
# @brief    Kconfig file.
# Copyright (c) HiSilicon (Shanghai) Technologies Co., Ltd. 2026-2026. All rights reserved.
#===============================================================================

menu "RADAR SoftAP Sample Configuration"

config WIFI_SSID
    string "Set WIFI SSID"
    default "my_softAP"
    help
        Configure the WiFi SSID for the RADAR SoftAP hotspot.

config WIFI_PWD
    string "Set WIFI password"
    default "123456789"
    help
        Configure the WiFi password (pre-shared key) for the RADAR SoftAP hotspot.

endmenu
```

## src/application/samples/radar/wireless_sample/Kconfig
```kconfig
#===============================================================================
# @brief    Kconfig file.
# Copyright (c) HiSilicon (Shanghai) Technologies Co., Ltd. 2026-2026. All rights reserved.
#===============================================================================

menu "RADAR WIRELESS Sample Configuration"

config WIFI_SSID
    string "Set WIFI SSID"
    default "my_softAP"
    help
        Configure the target WiFi SSID for RADAR WIRELESS STA connection.

config WIFI_PWD
    string "Set WIFI password"
    default "123456789"
    help
        Configure the WiFi password (pre-shared key) for RADAR WIRELESS STA connection.

endmenu
```

## src/application/samples/wifi/alilink_sample/Kconfig
```kconfig
#===============================================================================
# @brief    Kconfig file.
# Copyright (c) HiSilicon (Shanghai) Technologies Co., Ltd. 2026-2026. All rights reserved.
#===============================================================================

menu "ALILINK Sample Configuration"

config WIFI_SSID
    string "Set WIFI SSID"
    default "my_softAP"
    help
        Configure the target WiFi SSID for ALILINK STA connection.

config WIFI_PWD
    string "Set WIFI password"
    default "my_password"
    help
        Configure the WiFi password (pre-shared key) for ALILINK STA connection.

endmenu
```

## src/application/samples/wifi/softap_sample/Kconfig
```kconfig
#===============================================================================
# @brief    Kconfig file.
# Copyright (c) HiSilicon (Shanghai) Technologies Co., Ltd. 2026-2026. All rights reserved.
#===============================================================================

menu "SoftAP Sample Configuration"

config WIFI_SSID
    string "Set WIFI SSID"
    default "my_softAP"
    help
        Configure the WiFi SSID for the SoftAP hotspot.

config WIFI_PWD
    string "Set WIFI password"
    default "my_password"
    help
        Configure the WiFi password (pre-shared key) for the SoftAP hotspot.

endmenu
```

## src/application/samples/wifi/sta_sample/Kconfig
```kconfig
#===============================================================================
# @brief    Kconfig file.
# Copyright (c) HiSilicon (Shanghai) Technologies Co., Ltd. 2025-2025. All rights reserved.
#===============================================================================

menu "STA Sample Configuration"

config WIFI_SSID
    string "Set WIFI SSID"
    default "my_softAP"
    help
        Configure the target WiFi SSID for STA connection.

config WIFI_PWD
    string "Set WIFI password"
    default "my_password"
    help
        Configure the WiFi password (pre-shared key) for STA connection.

config SAMPLE_SUPPORT_MQTT
    bool
    prompt "Support WIFI MQTT Sample"
    depends on SAMPLE_SUPPORT_STA_SAMPLE
    default n
    help
        This option means support MQTT sample depends on sta sample.

if SAMPLE_SUPPORT_MQTT

    menu "MQTT Sample Configuration"

    config MQTT_USERNAME
        string "Set MQTT username"
        default "admin"
        help
            Configure the MQTT username for authentication.

    config MQTT_PASSWORD
        string "Set MQTT password"
        default "admin"
        help
            Configure the MQTT password for authentication.

    endmenu
endif

endmenu
```

## src/kernel/liteos/liteos_v208.5.0/Huawei_LiteOS/compat/freertos/Kconfig
```kconfig
config LOSCFG_COMPAT_FREERTOS
    bool "Enable FreeRTOS"
    default n
    help
      Answer Y to enable LiteOS support FreeRTOS interface.

config LOSCFG_COMPAT_FREERTOS_HEAP
    int "memory management method"
    default 3
    range 1 5
    depends on LOSCFG_COMPAT_FREERTOS
    help
      The numbers correspond to different memory management methods.
```

## src/kernel/liteos/liteos_v208.5.0/Huawei_LiteOS/compat/rt-thread/Kconfig
```kconfig
config LOSCFG_COMPAT_RT_THREAD
    bool "Enable RT_Thread"
    default n
    help
      Answer Y to enable LiteOS support RT_Thread interface.
```

## src/middleware/services/srv_tiot_host/Kconfig
```kconfig
#===============================================================================
# @brief    Kconfig file.
# Copyright (c) HiSilicon (Shanghai) Technologies Co., Ltd. 2024-2024. All rights reserved.
#===============================================================================
choice
    prompt "Choose Porting"
    config TIOT_PORTING_AIR_MOUSE
        bool "air_mouse"
    config TIOT_PORTING_BSXX_BRIDGE
        bool "bsxx_bridge"
    config TIOT_PORTING_CAXX_NFC
        bool "caxx_nfc"
    config TIOT_PORTING_WSXX_SLP
        bool "wsxx_slp"
        if TIOT_PORTING_WSXX_SLP
            config TIOT_WS63_UART_BUS
            int
            prompt "Configuring the Communication UART Bus"
            range 1 2
            default 1
        endif
endchoice
```

## src/open_source/Kconfig
```kconfig
#===============================================================================
# @brief    Kconfig file.
# Copyright (c) HiSilicon (Shanghai) Technologies Co., Ltd. 2026-2026. All rights reserved.
#===============================================================================
menu "Open Source Components"

config OPEN_SOURCE_LVGL
    bool "Enable LVGL (Light and Versatile Graphics Library)"
    default n
    help
        LVGL v9.4.0 embedded graphics library for building UIs.
        When enabled, sources under open_source/lvgl/ will be compiled.

        If your project does not need a GUI, disable this to reduce
        build time and firmware size.

if OPEN_SOURCE_LVGL

# Override LVGL Kconfig defaults for ws63 platform
choice LV_USE_OS
    default LV_OS_CMSIS_RTOS2
endchoice

config LV_MEM_SIZE_KILOBYTES
    default 128

config LV_DRAW_SW_COMPLEX
    default y

config LV_DRAW_THREAD_PRIO
    default 3

osource "open_source/lvgl/Kconfig"

endif

endmenu
```

## src/protocol/Kconfig
```kconfig
#===============================================================================
# @brief    Kconfig file.
# Copyright (c) HiSilicon (Shanghai) Technologies Co., Ltd. 2023-2023. All rights reserved.
#===============================================================================
menu "bt_host"
    comment "Config bluetooth."
    osource "protocol/bt/host/Kconfig"
endmenu

menu "bt_controller"
    comment "Config bluetooth."
    osource "protocol/bt/controller/Kconfig"
endmenu

menu "nfc"
    comment "Config nfc."
endmenu

menu "wifi"
    comment "Config wifi."
endmenu

menu "radar"
    config RADAR_SERVICE
    bool
    prompt "Enable Radar."
    default n
    help
        This option means support Radar.

    if RADAR_SERVICE
        menu "radar service"
            comment "Config radar service."
            osource "protocol/radar/plat/Kconfig"
        endmenu
    endif

    if RADAR_SERVICE
        choice
            prompt "select platform"
            default RADAR_PLT_SLP
            config RADAR_PLT_SUB_6G
                bool "SUB_6G"
            config RADAR_PLT_SLP
                bool "SLP"
        endchoice
    endif
    if RADAR_PLT_SLP
        config RADAR_HW_SPEC_ENABLE
        bool
        prompt "hw config special support"
        default n
        help
            This option means hw config special support.
    endif
endmenu
```

## vendor/HiHope_NearLink_DK_WS63E_V03/demo/lcd_st7796/Kconfig
```kconfig
#===============================================================================
# @brief    Kconfig file.
# Copyright (c) HiSilicon (Shanghai) Technologies Co., Ltd. 2023-2023. All rights reserved.
#===============================================================================
config SAMPLE_SUPPORT_ST7796
    bool
    prompt "Support ST7796."
    default y
    depends on SAMPLE_SUPPORT_LCD && OPEN_SOURCE_LVGL && SPI_SUPPORT_MASTER && SPI_SUPPORT_DMA
    help
        This option means support ST7796 IPS SPI LCD Sample.

config SPI_DI_PIN
    int
    prompt "Choose SPI DI PIN."
    depends on SAMPLE_SUPPORT_ST7796
    default 11

config SPI_DO_PIN
    int
    prompt "Choose SPI DO PIN."
    depends on SAMPLE_SUPPORT_ST7796
    default 9

config SPI_CLK_PIN
    int
    prompt "Choose SPI CLK PIN."
    depends on SAMPLE_SUPPORT_ST7796
    default 7

config SPI_CS_PIN
    int
    prompt "Choose SPI CS PIN."
    depends on SAMPLE_SUPPORT_ST7796
    default 8

config SPI_MASTER_PIN_MODE
    int
    prompt "Choose SPI MASTER PIN MODE."
    depends on SAMPLE_SUPPORT_ST7796
    default 3

config SPI_RS_PIN
    int
    prompt "Support SPI RS PIN."
    depends on SAMPLE_SUPPORT_ST7796
    default 1

config SPI_RST_PIN
    int
    prompt "Choose SPI RST PIN."
    depends on SAMPLE_SUPPORT_ST7796
    default 14

config SPI_BLK_PIN
    int
    prompt "Choose SPI BLK PIN."
    depends on SAMPLE_SUPPORT_ST7796
    default 12

config GPIO_PIN_MODE
    int
    prompt "Choose GPIO PIN MODE."
    depends on SAMPLE_SUPPORT_ST7796
    default 0
```

## vendor/Waveconn_WCL-63X-DK01/demo/button_demo/Kconfig
```kconfig
config GPIO_BUTTON_MODE_POLLING
    bool
    prompt "GPIO按键模式为轮询（选中为轮询，未选中为中断）"
    default y
    depends on ENABLE_BUTTON_SAMPLE
    help
        This option means the GPIO button mode of the currrent sample.
```

## vendor/Waveconn_WCL-63X-DK01/demo/uart_demo/Kconfig
```kconfig
#===============================================================================
# @brief    Kconfig file.
# Copyright (c) HiSilicon (Shanghai) Technologies Co., Ltd. 2023-2023. All rights reserved.
#===============================================================================
choice
    prompt "Sample"

config UART_POLL
    bool
    prompt "Support UART POLL Sample."
    default n
    depends on ENABLE_UART_SAMPLE
    help
        This option means support UART_POLL Sample.


config UART_INT
    bool
    prompt "Support UART INT Sample."
    default n
    depends on ENABLE_UART_SAMPLE
    help
        This option means support UART_INT Sample.

endchoice
```

## vendor/Waveconn_WCL-63X-DK01/demo/watchdog_demo/Kconfig
```kconfig
config WDT_TIMEOUT_SAMPLE
    bool
    prompt "Choose watchdog kick timeout."
    depends on ENABLE_WATCHDOG_SAMPLE
    default n

config WDT_KICK_SAMPLE
    bool
    prompt "Choose watchdog kick normally."
    depends on ENABLE_WATCHDOG_SAMPLE
    default n
```
